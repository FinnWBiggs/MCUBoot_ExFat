## build/Kconfig/Kconfig.shield.defconfig
```kconfig
osource "c:/users/finnb/documents/auli/mcuboot_exfat/boards/shields/*/Kconfig.defconfig"
osource "C:/ncs/v2.5.0/nrf/boards/shields/*/Kconfig.defconfig"
```

## build_dk/Kconfig/Kconfig.shield
```kconfig
osource "c:/users/finnb/documents/auli/mcuboot_exfat/boards/shields/*/Kconfig.shield"
osource "C:/ncs/v2.5.0/nrf/boards/shields/*/Kconfig.shield"
```
