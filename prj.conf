## CMakeLists.txt
```
# Top-level CMakeLists.txt for the skeleton application.
#
# Copyright (c) 2017 Open Source Foundries Limited
# Copyright (c) 2018 Foundries.io Ltd
#
# SPDX-License-Identifier: Apache-2.0
#
# This provides a basic application structure suitable for loading by
# mcuboot, which is easy to customize on a per-board basis. It can be
# used as a starting point for new applications.

cmake_minimum_required(VERSION 3.20.0)

# find_package(Zephyr) in order to load application boilerplate:
# https://docs.zephyrproject.org/latest/develop/application/index.html
find_package(Zephyr REQUIRED HINTS $ENV{ZEPHYR_BASE})
project(MCUBOOT_EXFAT)

# This string ends up getting printed in the device console
if (NOT DEFINED FROM_WHO)
  set(FROM_WHO Zephyr)
endif()

target_compile_definitions(app PRIVATE "-DMCUBOOT_HELLO_WORLD_FROM=\"${FROM_WHO}\"")

target_sources_ifdef(
  CONFIG_REAL_MAIN
  app PRIVATE 
  src/real_main.c
)

if(NOT CONFIG_REAL_MAIN)
  message("NOT REAL MAIN")
  target_sources(
    app PRIVATE 
    src/stub_main.c
  )
endif()

if(CONFIG_BUILD_WITH_TFM)
  target_include_directories(app PRIVATE
    $<TARGET_PROPERTY:tfm,TFM_BINARY_DIR>/install/interface/include
  )
endif()
```

## Kconfig
```
# Copyright (c) 2019-2020 Nordic Semiconductor ASA
# SPDX-License-Identifier: Apache-2.0

config REAL_MAIN
	bool "Option to determine whether the compiled main of this sample is real or a stub"
	
config APP_WIPE_STORAGE
	bool "Option to clear the flash area before mounting"
	help
	  Use this to force an existing file system to be created.

choice
	prompt "Storage and file system type used by the application"
	default APP_MSC_STORAGE_NONE
	help
	  Specify the type of storage and file system.

config APP_MSC_STORAGE_NONE
	bool "Use RAM disk as block device"
	imply DISK_DRIVER_RAM

config APP_MSC_STORAGE_RAM
	bool "Use RAM disk and FAT file system"
	imply DISK_DRIVER_RAM
	imply FILE_SYSTEM
	imply FAT_FILESYSTEM_ELM

config APP_MSC_STORAGE_FLASH_FATFS
	bool "Use FLASH disk and FAT file system"
	imply DISK_DRIVER_FLASH
	imply FILE_SYSTEM
	imply FAT_FILESYSTEM_ELM

config APP_MSC_STORAGE_FLASH_LITTLEFS
	bool "Use FLASH disk and LittleFS"
	imply DISK_DRIVER_FLASH
	imply FILE_SYSTEM
	imply FILE_SYSTEM_LITTLEFS

config APP_MSC_STORAGE_SDCARD
	bool "Use SDHC and FAT file system"
	imply DISK_DRIVER_SDMMC
	imply FILE_SYSTEM
	imply FAT_FILESYSTEM_ELM

endchoice

config DISK_RAM_VOLUME_SIZE
	int "Ram Volume Size"
	default 32 if APP_MSC_STORAGE_NONE

config MASS_STORAGE_DISK_NAME
	default "NAND" if DISK_DRIVER_FLASH
	default "RAM" if DISK_DRIVER_RAM
	default "SD" if DISK_DRIVER_SDMMC

if DISK_DRIVER_FLASH

config FLASH_MAP
	default y

config FLASH_PAGE_LAYOUT
	default y

config FLASH_LOG_LEVEL
	default 3

if NORDIC_QSPI_NOR

config NORDIC_QSPI_NOR_FLASH_LAYOUT_PAGE_SIZE
	default 4096

endif # NORDIC_QSPI_NOR

endif # DISK_DRIVER_FLASH

source "Kconfig.zephyr"
```

## sample.yaml
```
sample:
  name: MCUBoot_ExFat
tests:
  sample.usb.mass_ram_none:
    min_ram: 64
    depends_on: usb_device
    arch_exclude: posix
    extra_configs:
      - CONFIG_LOG_DEFAULT_LEVEL=3
    tags:
      - msd
      - usb
    harness: console
    harness_config:
      type: multi_line
      ordered: true
      regex:
        - "No file system selected"
        - "The device is put in USB mass storage mode."
  sample.usb_device_next.mass_ram_none:
    min_ram: 64
    depends_on: usb_device
    platform_allow:
      - nrf52840dk_nrf52840
      - frdm_k64f
    extra_args: CONF_FILE="usbd_next_prj.conf"
    extra_configs:
      - CONFIG_LOG_DEFAULT_LEVEL=3
    tags:
      - msd
      - usb
    harness: console
    harness_config:
      type: multi_line
      ordered: true
      regex:
        - "No file system selected"
        - "The device is put in USB mass storage mode."
  sample.usb.mass_ram_fat:
    min_ram: 128
    depends_on: usb_device
    arch_exclude: posix
    extra_configs:
      - CONFIG_LOG_DEFAULT_LEVEL=3
      - CONFIG_APP_MSC_STORAGE_RAM=y
    tags:
      - msd
      - usb
    harness: console
    harness_config:
      type: multi_line
      ordered: true
      regex:
        - "End of files"
        - "The device is put in USB mass storage mode."
  sample.usb.mass_flash_fatfs:
    min_ram: 32
    modules:
      - fatfs
    depends_on: usb_device
    filter: dt_compat_enabled("nordic,qspi-nor")
    platform_allow:
      - nrf52840dk_nrf52840
      - nrf5340dk_nrf5340_cpuapp
      - adafruit_feather_nrf52840
    integration_platforms:
      - nrf52840dk_nrf52840
    extra_configs:
      - CONFIG_LOG_DEFAULT_LEVEL=3
      - CONFIG_APP_MSC_STORAGE_FLASH_FATFS=y
    tags:
      - msd
      - usb
    harness: console
    harness_config:
      type: multi_line
      ordered: true
      regex:
        - "End of files"
        - "The device is put in USB mass storage mode."
  sample.usb_device_next.mass_flash_fatfs:
    min_ram: 32
    modules:
      - fatfs
    depends_on: usb_device
    filter: dt_compat_enabled("nordic,qspi-nor")
    platform_allow:
      - nrf52840dk_nrf52840
      - nrf5340dk_nrf5340_cpuapp
      - adafruit_feather_nrf52840
    integration_platforms:
      - nrf52840dk_nrf52840
    extra_args: CONF_FILE="usbd_next_prj.conf"
    extra_configs:
      - CONFIG_LOG_DEFAULT_LEVEL=3
      - CONFIG_APP_MSC_STORAGE_FLASH_FATFS=y
    tags:
      - msd
      - usb
    harness: console
    harness_config:
      type: multi_line
      ordered: true
      regex:
        - "End of files"
        - "The device is put in USB mass storage mode."
  sample.usb.mass_sdhc_fatfs:
    min_ram: 32
    modules:
      - fatfs
    depends_on:
      - usb_device
      - sdhc
    extra_configs:
      - CONFIG_LOG_DEFAULT_LEVEL=3
      - CONFIG_APP_MSC_STORAGE_SDCARD=y
    tags:
      - msd
      - usb
    harness: console
    harness_config:
      fixture: fixture_sdcard
      type: multi_line
      ordered: true
      regex:
        - "End of files"
        - "The device is put in USB mass storage mode."
  sample.usb.mass_flash_littlefs:
    modules:
      - littlefs
    min_ram: 32
    depends_on: usb_device
    filter: dt_compat_enabled("nordic,qspi-nor")
    platform_allow:
      - nrf52840dk_nrf52840
      - nrf5340dk_nrf5340_cpuapp
      - adafruit_feather_nrf52840
    integration_platforms:
      - nrf52840dk_nrf52840
    extra_configs:
      - CONFIG_LOG_DEFAULT_LEVEL=3
      - CONFIG_APP_MSC_STORAGE_FLASH_LITTLEFS=y
    tags:
      - msd
      - usb
    harness: console
    harness_config:
      type: multi_line
      ordered: true
      regex:
        - "End of files"
        - "The device is put in USB mass storage mode."
```

## prj.conf
```kconfig
################################################################
# Option: enable this to compile with the main from the mass sample. 
# When this is set to 'n' the main is "stub_main.c", which does nothing but return 0
CONFIG_REAL_MAIN=n

# Enable Zephyr application to be booted by MCUboot
# CONFIG_BOOTLOADER_MCUBOOT=y
CONFIG_PM_SINGLE_IMAGE=y
################################################################
# Added based on entries in (mass) sample.yaml (included!)
# Extra CONF options for sample.usb.mass_flash_fatfs

# CONFIG_APP_MSC_STORAGE_FLASH_LITTLEFS=y

CONFIG_APP_MSC_STORAGE_FLASH_FATFS=y
    # Causing problems -- break down into
    # DISK_DRIVER_FLASH
    # FILE_SYSTEM
    # FAT_FILESYSTEM_ELM

# CONFIG_DISK_DRIVERS=y
# CONFIG_DISK_DRIVER_FLASH=y
#     # Causing Problems, Break into
#     # FLASH
#     # FLASH_MAP

# CONFIG_FLASH=y
# CONFIG_FLASH_MAP=y

# CONFIG_FILE_SYSTEM=y
    # Not causing problems -- leave alone

# CONFIG_FAT_FILESYSTEM_ELM=y
    # Not causing problems -- leave alone

################################################################
# Applcation Skeleton
# bootloader/mcuboot/samples/zephyr/hello-world

# Print a banner on the UART on startup.
# CONFIG_BOOT_BANNER=y

# Enable console and printk()
# CONFIG_PRINTK=y
CONFIG_STDOUT_CONSOLE=y

################################################################
# Mass Storage
# zephyr/samples/subsys/usb/mass

# USB related configs
CONFIG_USB_DEVICE_STACK=y
CONFIG_USB_DEVICE_PRODUCT="Zephyr MSC sample"
CONFIG_USB_DEVICE_PID=0x0008
CONFIG_LOG=y
CONFIG_USB_DRIVER_LOG_LEVEL_ERR=y
CONFIG_USB_MASS_STORAGE=y
CONFIG_USB_DEVICE_LOG_LEVEL_ERR=y
CONFIG_USB_MASS_STORAGE_LOG_LEVEL_ERR=y
CONFIG_USB_DEVICE_INITIALIZE_AT_BOOT=n

CONFIG_MAIN_STACK_SIZE=1536
```

## boards/nrf52840dk_nrf52840.overlay
```dts
&mx25r64 {
    partitions {
        compatible = "fixed-partitions";
        #address-cells = <1>;
        #size-cells = <1>;
        
    };
};

/ {
    chosen {
        nordic,pm-ext-flash = &mx25r64;
    };
};
```

## src/main.c
```c
/*
 * Copyright (c) 2016 Intel Corporation.
 * Copyright (c) 2019-2020 Nordic Semiconductor ASA
 *
 * SPDX-License-Identifier: Apache-2.0
 */

/*
 * This is the main.c from the Mass Storage Sample.
 * Note, however, that I trimmed out #defines that were not enabled for
 * my build system
 *
 */

#include <zephyr/kernel.h>
#include <zephyr/logging/log.h>
#include <zephyr/usb/usb_device.h>
#include <zephyr/usb/usbd.h>
#include <zephyr/usb/class/usbd_msc.h>
#include <zephyr/fs/fs.h>
#include <stdio.h>

LOG_MODULE_REGISTER(main);

// #if CONFIG_DISK_DRIVER_FLASH
#include <zephyr/storage/flash_map.h>
// #endif

#if CONFIG_FAT_FILESYSTEM_ELM
#include <ff.h>
#endif

#define STORAGE_PARTITION		auli_storage
#define STORAGE_PARTITION_ID	FIXED_PARTITION_ID(STORAGE_PARTITION)

static struct fs_mount_t fs_mnt;

static int setup_flash(struct fs_mount_t *mnt)
{
	int rc = 0;
// #if CONFIG_DISK_DRIVER_FLASH
	unsigned int id;
	const struct flash_area *pfa;

	mnt->storage_dev = (void *)STORAGE_PARTITION_ID;
	id = STORAGE_PARTITION_ID;

	rc = flash_area_open(id, &pfa);
	printk("Area %u at 0x%x on %s for %u bytes\n",
	       id, (unsigned int)pfa->fa_off, pfa->fa_dev->name,
	       (unsigned int)pfa->fa_size);

	if (rc < 0 && IS_ENABLED(CONFIG_APP_WIPE_STORAGE)) {
		printk("Erasing flash area ... ");
		rc = flash_area_erase(pfa, 0, pfa->fa_size);
		printk("%d\n", rc);
	}

	if (rc < 0) {
		flash_area_close(pfa);
	}
// #endif
	return rc;
}

static int mount_app_fs(struct fs_mount_t *mnt)
{
	int rc;

#if CONFIG_FAT_FILESYSTEM_ELM
	static FATFS fat_fs;

	mnt->type = FS_FATFS;
	mnt->fs_data = &fat_fs;
	if (IS_ENABLED(CONFIG_DISK_DRIVER_RAM)) {
		mnt->mnt_point = "/RAM:";
	} else if (IS_ENABLED(CONFIG_DISK_DRIVER_SDMMC)) {
		mnt->mnt_point = "/SD:";
	} else {
		mnt->mnt_point = "/NAND:";
	}
#endif
	rc = fs_mount(mnt);

	return rc;
}

static void setup_disk(void)
{
	struct fs_mount_t *mp = &fs_mnt;
	struct fs_dir_t dir;
	struct fs_statvfs sbuf;
	int rc;

	fs_dir_t_init(&dir);

	if (IS_ENABLED(CONFIG_DISK_DRIVER_FLASH)) {
		rc = setup_flash(mp);
		if (rc < 0) {
			LOG_ERR("Failed to setup flash area");
			return;
		}
	}

	if (!IS_ENABLED(CONFIG_FILE_SYSTEM_LITTLEFS) &&
	    !IS_ENABLED(CONFIG_FAT_FILESYSTEM_ELM)) {
		LOG_INF("No file system selected");
		return;
	}

	rc = mount_app_fs(mp);
	if (rc < 0) {
		LOG_ERR("Failed to mount filesystem");
		return;
	}

	/* Allow log messages to flush to avoid interleaved output */
	k_sleep(K_MSEC(50));

	printk("Mount %s: %d\n", fs_mnt.mnt_point, rc);

	rc = fs_statvfs(mp->mnt_point, &sbuf);
	if (rc < 0) {
		printk("FAIL: statvfs: %d\n", rc);
		return;
	}

	printk("%s: bsize = %lu ; frsize = %lu ;"
	       " blocks = %lu ; bfree = %lu\n",
	       mp->mnt_point,
	       sbuf.f_bsize, sbuf.f_frsize,
	       sbuf.f_blocks, sbuf.f_bfree);

	rc = fs_opendir(&dir, mp->mnt_point);
	printk("%s opendir: %d\n", mp->mnt_point, rc);

	if (rc < 0) {
		LOG_ERR("Failed to open directory");
	}

	while (rc >= 0) {
		struct fs_dirent ent = { 0 };

		rc = fs_readdir(&dir, &ent);
		if (rc < 0) {
			LOG_ERR("Failed to read directory entries");
			break;
		}
		if (ent.name[0] == 0) {
			printk("End of files\n");
			break;
		}
		printk("  %c %u %s\n",
		       (ent.type == FS_DIR_ENTRY_FILE) ? 'F' : 'D',
		       ent.size,
		       ent.name);
	}

	(void)fs_closedir(&dir);

	return;
}

int main(void)
{
	int ret;

	setup_disk();

#if defined(CONFIG_USB_DEVICE_STACK_NEXT)
	ret = enable_usb_device_next();
#else
	ret = usb_enable(NULL);
#endif
	if (ret != 0) {
		LOG_ERR("Failed to enable USB");
		return 0;
	}

	LOG_INF("The device is put in USB mass storage mode.\n");
	return 0;
}
```

## src/badmain.c
```c
#include <zephyr/kernel.h>

int main(void) {
    return 0;
}
```

## src/real_main.c
```c
/*
 * Copyright (c) 2016 Intel Corporation.
 * Copyright (c) 2019-2020 Nordic Semiconductor ASA
 *
 * SPDX-License-Identifier: Apache-2.0
 */

/*
 * This is the main.c from the Mass Storage Sample.
 * Note, however, that I trimmed out #defines that were not enabled for
 * my build system
 *
 */

#include <zephyr/kernel.h>
#include <zephyr/logging/log.h>
#include <zephyr/usb/usb_device.h>
#include <zephyr/usb/usbd.h>
#include <zephyr/usb/class/usbd_msc.h>
#include <zephyr/fs/fs.h>
#include <stdio.h>

LOG_MODULE_REGISTER(main);

#if CONFIG_DISK_DRIVER_FLASH
#include <zephyr/storage/flash_map.h>
#endif

#if CONFIG_FAT_FILESYSTEM_ELM
#include <ff.h>
#endif

#define STORAGE_PARTITION		fatfs_storage
#define STORAGE_PARTITION_ID	FIXED_PARTITION_ID(STORAGE_PARTITION)

static struct fs_mount_t fs_mnt;

static int setup_flash(struct fs_mount_t *mnt)
{
	int rc = 0;
#if CONFIG_DISK_DRIVER_FLASH
	unsigned int id;
	const struct flash_area *pfa;

	mnt->storage_dev = (void *)STORAGE_PARTITION_ID;
	id = STORAGE_PARTITION_ID;

	rc = flash_area_open(id, &pfa);
	printk("Area %u at 0x%x on %s for %u bytes\n",
	       id, (unsigned int)pfa->fa_off, pfa->fa_dev->name,
	       (unsigned int)pfa->fa_size);

	if (rc < 0 && IS_ENABLED(CONFIG_APP_WIPE_STORAGE)) {
		printk("Erasing flash area ... ");
		rc = flash_area_erase(pfa, 0, pfa->fa_size);
		printk("%d\n", rc);
	}

	if (rc < 0) {
		flash_area_close(pfa);
	}
#endif
	return rc;
}

static int mount_app_fs(struct fs_mount_t *mnt)
{
	int rc;

#if CONFIG_FAT_FILESYSTEM_ELM
	static FATFS fat_fs;

	mnt->type = FS_FATFS;
	mnt->fs_data = &fat_fs;
	if (IS_ENABLED(CONFIG_DISK_DRIVER_RAM)) {
		mnt->mnt_point = "/RAM:";
	} else if (IS_ENABLED(CONFIG_DISK_DRIVER_SDMMC)) {
		mnt->mnt_point = "/SD:";
	} else {
		mnt->mnt_point = "/NAND:";
	}
#endif
	rc = fs_mount(mnt);

	return rc;
}

static void setup_disk(void)
{
	struct fs_mount_t *mp = &fs_mnt;
	struct fs_dir_t dir;
	struct fs_statvfs sbuf;
	int rc;

	fs_dir_t_init(&dir);

	if (IS_ENABLED(CONFIG_DISK_DRIVER_FLASH)) {
		rc = setup_flash(mp);
		if (rc < 0) {
			LOG_ERR("Failed to setup flash area");
			return;
		}
	}

	if (!IS_ENABLED(CONFIG_FILE_SYSTEM_LITTLEFS) &&
	    !IS_ENABLED(CONFIG_FAT_FILESYSTEM_ELM)) {
		LOG_INF("No file system selected");
		return;
	}

	rc = mount_app_fs(mp);
	if (rc < 0) {
		LOG_ERR("Failed to mount filesystem");
		return;
	}

	/* Allow log messages to flush to avoid interleaved output */
	k_sleep(K_MSEC(50));

	printk("Mount %s: %d\n", fs_mnt.mnt_point, rc);

	rc = fs_statvfs(mp->mnt_point, &sbuf);
	if (rc < 0) {
		printk("FAIL: statvfs: %d\n", rc);
		return;
	}

	printk("%s: bsize = %lu ; frsize = %lu ;"
	       " blocks = %lu ; bfree = %lu\n",
	       mp->mnt_point,
	       sbuf.f_bsize, sbuf.f_frsize,
	       sbuf.f_blocks, sbuf.f_bfree);

	rc = fs_opendir(&dir, mp->mnt_point);
	printk("%s opendir: %d\n", mp->mnt_point, rc);

	if (rc < 0) {
		LOG_ERR("Failed to open directory");
	}

	while (rc >= 0) {
		struct fs_dirent ent = { 0 };

		rc = fs_readdir(&dir, &ent);
		if (rc < 0) {
			LOG_ERR("Failed to read directory entries");
			break;
		}
		if (ent.name[0] == 0) {
			printk("End of files\n");
			break;
		}
		printk("  %c %u %s\n",
		       (ent.type == FS_DIR_ENTRY_FILE) ? 'F' : 'D',
		       ent.size,
		       ent.name);
	}

	(void)fs_closedir(&dir);

	return;
}

int main(void)
{
	int ret;

	setup_disk();

#if defined(CONFIG_USB_DEVICE_STACK_NEXT)
	ret = enable_usb_device_next();
#else
	ret = usb_enable(NULL);
#endif
	if (ret != 0) {
		LOG_ERR("Failed to enable USB");
		return 0;
	}

	LOG_INF("The device is put in USB mass storage mode.\n");
	return 0;
}
```
